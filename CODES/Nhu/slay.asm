PROCESSOR PIC16F877A
#INCLUDE<P16F877A.INC>
__CONFIG _HS_OSC&_WDT_OFF&_BODEN_OFF&_PWRTE_OFF&_WRT_OFF&_CPD_OFF&_LVP_OFF
CBLOCK 0X20
COUNT


ENDC
ORG 0X00
GOTO MAIN
MAIN

BSF STATUS,5
MOVLW 0XFF
MOVWF TRISD  ; PORTD NHAP DU LIEU
CLRF TRISB   ; PORTB XUAT DU LIEU
MOVLW 0X07
MOVWF ADCON1  ; PORTA XUAT NHAP DU LIEU
BCF TRISC,5  ; PHAT DU LIEU
BSF TRISC,4  ; NHAN DU LIEU
BSF TRISC,3  ; NHAN XUNG CLOCK
BSF TRISA,5  ; CHON GIAO TIEP
MOVLW 0X00
MOVWF SSPSTAT
BCF STATUS,5  ; BANK0
BSF SSPCON,5  ;
BCF SSPCON,4  ; MUC LOGIC CUA XUNG TRONG THOI GIAN CHO
BCF SSPCON,3
BSF SSPCON,2
BCF SSPCON,1
BCF SSPCON,0  ; CHON SLAVE, BAT CHAN RA5
clrf PORTB

LOOP
MOVF SSPBUF,0
MOVF PORTD,0 ; DULIEU TRUYEN
MOVWF SSPBUF

BSF STATUS,5
BTFSS SSPSTAT,0
GOTO $-1
BCF STATUS,5
MOVF SSPBUF,0
MOVWF PORTB

GOTO LOOP
END